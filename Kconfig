## Kconfig
```kconfig
#
# Copyright 2015, Wink Saville
#
# This software may be distributed and modified according to the terms of
# the BSD 2-Clause license. Note that NO WARRANTY is provided.
# See "LICENSE_BSD2.txt" for details.
#

menuconfig LIB_SEL4_STARTSTOP
    bool "Build sel4 start stop library"
    default n
    help
        "Build the library which defines seL4_Start and seL4_Stop"
```
